## vendor/oplus/kernel/oplus_performance/oplus_healthinfo/main/Kconfig
```kconfig
#ifdef OPLUS_FEATURE_HEALTHINFO
config OPLUS_HEALTHINFO
bool "config oplus healthinfo"
help
    define this config to init oplus healthinfo.
config OPLUS_BLK_MONITOR
	bool "OPlus block request latency monitor"
	depends on OPLUS_HEALTHINFO
	default n
	help
	  Collect the donor Q2I, I2D, Q2C, and D2C request-latency
	  statistics and expose them through oplus_healthinfo.
config CAMERA_OPT
	bool "config camera opt"
	default n
	help
	  reduce camera provider task runnable time
config MMAP_LOCK_OPT
	bool "config mmap lock opt boos"
	default n
	help
	  reduce sleep time in mmap lock
#endif /* OPLUS_FEATURE_HEALTHINFO */
```

## vendor/oplus/kernel/oplus_performance/oplus_healthinfo/mm/Kconfig
```kconfig
#ifdef OPLUS_FEATURE_HEALTHINFO
config OPLUS_MEM_MONITOR
	bool "memory monitor "
	default n
	help
	 memory monitor.

config OPLUS_ATHENA_MEMORY_ABI
	bool "Athena allocator and swappiness ABI"
	depends on OPLUS_HEALTHINFO && SLABINFO && !SLOB && OPLUS_ZRAM_OPT
	default n
	help
	  Expose the low-overhead allocator totals and reclaim controls used by
	  the Android 14 OnePlus Athena and Performance AIDL services.  This does
	  not enable the donor's allocation stack tracking or debug caches.
#endif /* OPLUS_FEATURE_HEALTHINFO */
```

## vendor/oplus/kernel/oplus_performance/sched_assist/Kconfig
```kconfig
config OPLUS_FEATURE_SCHED_ASSIST
	tristate "sched_assist"
	default n
	help
	  turning sched for ui, render and so on to improve UX

config OPLUS_FEATURE_SCHED_UX_PRIORITY
	bool "Ordered UX priority scheduling"
	default n
	depends on OPLUS_FEATURE_SCHED_ASSIST
	help
	  Enable the OnePlus 9R ordered UX runqueue and execution budgets.

config OPLUS_UX_IM_FLAG
	bool "OPlus sched_assist IM flag classification"
	depends on OPLUS_FEATURE_SCHED_ASSIST
	default n
	help
	  Enable the donor IM flag classification used to identify audio tasks.

config OPLUS_CPU_AUDIO_PERF
	tristate "Boost audio RT task placement"
	depends on OPLUS_UX_IM_FLAG
	default n
	help
	  Avoid placing marked audio RT tasks on CPUs whose current idle state
	  has the high exit latency rejected by the OnePlus 9R scheduler.

config OPLUS_FEATURE_AUDIO_OPT
	bool "OPlus audio small-task scheduling"
	depends on OPLUS_FEATURE_SCHED_ASSIST
	default n
	help
	  Track short-running tasks in the active audio process during the camera
	  scene and preserve the OnePlus 9R next-buddy/preemption preference.

config OPLUS_FEATURE_EAS_OPT
	bool "Oplus EAS optimization control plane"
	default n
	help
	  Expose the OnePlus 9R EAS master control and parent directory.

config OPLUS_FEATURE_VT_CAP
	bool "Oplus virtual CPU capacity and group adjustment"
	depends on OPLUS_FEATURE_EAS_OPT
	default n
	help
	  Apply the OnePlus 9R capacity and task-group placement controls.

config OPLUS_CPUFREQ_IOWAIT_PROTECT
	bool "Oplus schedutil I/O-wait protection"
	depends on OPLUS_FEATURE_EAS_OPT
	default n
	help
	  Expose and apply the OnePlus 9R schedutil I/O-wait controls.

config OPLUS_LOCKING_STRATEGY
	bool "OnePlus 9R locking strategy"
	depends on OPLUS_FEATURE_SCHED_ASSIST
	default n
	help
	  Enable the donor mutex, rwsem, and ART futex locking strategy ABI.

config OPLUS_LOCKING_OSQ
	bool "OnePlus 9R optimistic-spin controls"
	depends on OPLUS_LOCKING_STRATEGY
	default n
	help
	  Enable the donor mutex and rwsem optimistic-spin policy controls.

config OPLUS_LOCKING_MONITOR
	bool "OnePlus 9R locking statistics monitor"
	depends on OPLUS_LOCKING_STRATEGY
	default n
	help
	  Expose the donor lock statistics and threshold control plane.
```

## vendor/oplus/kernel/oplus_performance/sched_info/Kconfig
```kconfig
config OPLUS_FEATURE_CPU_JANKINFO
	tristate "Oplus CPU jank proc ABI"
	depends on PROC_FS
	default n
	help
	  Provides the Android 14 ColorOS /proc/jank_info/cpu_jank_info
	  control plane on older Oplus scheduler-assist kernels.
```

## vendor/oplus/kernel/oplus_performance/sigkill_diagnosis/Kconfig
```kconfig
# SPDX-License-Identifier: GPL-2.0-only
# Copyright (C) 2018-2020 Oplus. All rights reserved.

config OPLUS_FEATURE_SIGKILL_DIAGNOSIS
	bool "sigkill diagnosis driver"
	default n
	help
	  Assist SIGKILL diagnosis by recording kill reason categories for
	  Athena. The 4.14 port is built-in because kernel/signal.c calls the
	  recorder directly in place of the 5.4 Android vendor hook.
```

## vendor/oplus/kernel/power/subsys_sleep_monitor/Kconfig
```kconfig
config OPLUS_SUBSYS_SLEEP_MONITOR
	tristate "Qualcomm subsystem sleep monitor"
	default n
	help
	  Export the Qualcomm ADSP, CDSP and SLPI low-power voting records
	  used by the ColorOS subsystem low-power parser.
```
